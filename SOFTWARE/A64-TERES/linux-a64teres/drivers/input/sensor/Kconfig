## SOFTWARE/A64-TERES/linux-a64teres/drivers/input/sensor/Kconfig
```kconfig
#
# sensor driver configuration
#
menuconfig INPUT_SENSOR
	bool "Sensors"
	help
	  Say Y here, and a list of supported sensor will be displayed.
	  This option doesn't affect the kernel.

	  If unsure, say Y.

if INPUT_SENSOR
config SENSORS_BMA250
        tristate "BMA250 acceleration sensor support"
        select I2C
        depends on INPUT_SENSOR
        default m
        help
          If you say yes here you get support for Bosch Sensortec's
          acceleration sensors BMA250.

config SENSORS_SC7A30
        tristate "SC7A30 3-Axis Orientation/Motion Detection Sensor Support"
        select I2C
        depends on INPUT_SENSOR
        default m
        help
          If you say yes here you get support for the Freescale 3-Axis
          Orientation/Motion Detection Sensor.

config SENSORS_MMA7660
        tristate "MMA7660 3-Axis Orientation/Motion Detection Sensor Support"
        select I2C
        depends on INPUT_SENSOR
        default m
        help
          If you say yes here you get support for the Freescale 3-Axis
          Orientation/Motion Detection Sensor.
          
config SENSORS_MXC622X
        tristate "MXC622X 2-Axis Orientation/Motion Detection Sensor Support"
        select I2C
        depends on INPUT_SENSOR
        default m
        help
          If you say yes here you get support for the MXC622X 2-Axis
          Orientation/Motion Detection Sensor.

config SENSORS_MMA8452
        tristate "MMA8452 3-Axis Orientation/Motion Detection Sensor Support"
        select I2C
        depends on INPUT_SENSOR
        default m
        help
          If you say yes here you get support for the Freescale 3-Axis
          Orientation/Motion Detection Sensor.

config SENSORS_MMA865X
        tristate "MMA865X 3-Axis Orientation/Motion Detection Sensor Support"
        select I2C
        depends on INPUT_SENSOR
        default m
        help
          If you say yes here you get support for the Freescale 3-Axis
          Orientation/Motion Detection Sensor.			  
endif
```

## SOFTWARE/A64-TERES/linux-a64teres/drivers/input/touchscreen/bcd/Kconfig
```kconfig
#
#  Touchscreen tu_ts driver configuration
#

config TOUCHSCREEN_TU_TS
       tristate  "tu_ts touchscreen driver"
       default m
       depends on INPUT && I2C
       help
         BCD touchscreen driver
```

## SOFTWARE/A64-TERES/linux-a64teres/drivers/input/touchscreen/ft5x/Kconfig
```kconfig
#
#  Touchscreen ft5x driver configuration
#

config TOUCHSCREEN_FT5X_TS
       tristate  "ft5x touchscreen driver"
       default m
       depends on INPUT && I2C
       help
         ft5x touchscreen driver
```

## SOFTWARE/A64-TERES/linux-a64teres/drivers/input/touchscreen/gslx680new/Kconfig
```kconfig
#
#  Touchscreen driver configuration
#
config  TOUCHSCREEN_GSLX680NEW
       tristate  "gslX680NEW touchscreen driver"      
       depends on INPUT && I2C
       default m
       help
         gsl168X,gsl268X,gsl368X touchscreen new driver,optimize anti-shake    
         
```

## SOFTWARE/A64-TERES/linux-a64teres/drivers/input/touchscreen/gt818/Kconfig
```kconfig
#
#  Touchscreen driver configuration
#

config  TOUCHSCREEN_GT818_TS
       tristate  "gt818 touchscreen driver"      
       depends on INPUT && I2C
       default m
       help
         gt818 touchscreen driver    
```

## SOFTWARE/A64-TERES/linux-a64teres/drivers/input/touchscreen/gt911/Kconfig
```kconfig
#
#  Touchscreen driver configuration
#

config  TOUCHSCREEN_GT911_TS
       tristate  "gt911 touchscreen driver"      
       depends on INPUT && I2C
	   depends on ARCH_SUN8IW8
       default m
       help
         gt911 touchscreen driver    
```

## SOFTWARE/A64-TERES/linux-a64teres/drivers/input/touchscreen/gt9xx/Kconfig
```kconfig
#
#  Touchscreen driver configuration
#
config  TOUCHSCREEN_GT9XX_TS
       tristate  "gt9xx touchscreen driver"      
       depends on INPUT && I2C
       default m
       help
         gt9xx touchscreen driver    
         
```

## SOFTWARE/A64-TERES/linux-a64teres/drivers/input/touchscreen/gt9xxnew/Kconfig
```kconfig
#
#  Touchscreen driver configuration
#
config  TOUCHSCREEN_GT9XXNEW_TS
       tristate  "gt9xxnew touchscreen driver"      
       depends on INPUT && I2C
       default m
       help
         gt9xxnew touchscreen driver    
         
```

## SOFTWARE/A64-TERES/linux-a64teres/drivers/media/cedar-ve/Kconfig
```kconfig
config VIDEO_ENCODER_DECODER_SUNXI
	tristate "sunxi video encoder and decoder support"
	default y
	---help---
	  This is the driver for sunxi video decoder, including h264/
	  mpeg4/mpeg2/vc1/rmvb. 
	  To compile this driver as a module, choose M here: the
	  module will be called cedar_dev.
```

## SOFTWARE/A64-TERES/linux-a64teres/drivers/misc/sunxi-rf/Kconfig
```kconfig
#
# Allwinner rfkill driver.
#
config SUNXI_RFKILL
  bool "Allwinner rfkill driver"
  depends on WIRELESS || RFKILL
  help
    allwinner rfkill driver
```

## SOFTWARE/A64-TERES/linux-a64teres/drivers/pinctrl/sunxi/Kconfig
```kconfig
menu "Allwinner SOC PINCTRL DRIVER"
	depends on ARCH_SUNXI
config PINCTRL_SUNXI_COMMON
	bool
	select PINMUX
	select GENERIC_PINCONF

config PINCTRL_SUNXI_TEST
	tristate "pinctrl sunxi test driver"
	default m

config PINCTRL_SUN4I_A10
	def_bool MACH_SUN4I
	select PINCTRL_SUNXI_COMMON

config PINCTRL_SUN5I_A10S
	def_bool MACH_SUN5I
	select PINCTRL_SUNXI_COMMON

config PINCTRL_SUN5I_A13
	def_bool MACH_SUN5I
	select PINCTRL_SUNXI_COMMON

config PINCTRL_SUN6I_A31
	def_bool MACH_SUN6I
	select PINCTRL_SUNXI_COMMON

config PINCTRL_SUN6I_A31_R
	def_bool MACH_SUN6I
	depends on RESET_CONTROLLER
	select PINCTRL_SUNXI_COMMON

config PINCTRL_SUN7I_A20
	def_bool MACH_SUN7I
	select PINCTRL_SUNXI_COMMON

config PINCTRL_SUN8I_A23
	def_bool MACH_SUN8I
	select PINCTRL_SUNXI_COMMON

config PINCTRL_SUN8I_A23_R
	def_bool MACH_SUN8I
	depends on RESET_CONTROLLER
	select PINCTRL_SUNXI_COMMON

config PINCTRL_SUN8IW10P1
	def_bool ARCH_SUN8IW10
        bool "Pinctrl sun8iw10p1 PIO controller"
	select PINCTRL_SUNXI_COMMON
	
config PINCTRL_SUN8IW11P1
	def_bool ARCH_SUN8IW11
	depends on ARCH_SUN8IW11
	bool "Pinctrl sun8iw11p1 PIO controller"
	select PINCTRL_SUNXI_COMMON
	
config PINCTRL_SUN50IW1P1
        bool "Pinctrl sun50i PIO controller"
	select PINCTRL_SUNXI_COMMON
config PINCTRL_SUN50IW1P1_R
        bool "Pinctrl sun50i R_PIO controller"
	#depends on RESET_CONTROLLER
	select PINCTRL_SUNXI_COMMON
endmenu
```

## SOFTWARE/A64-TERES/linux-a64teres/drivers/power/axp_power/Kconfig
```kconfig
menuconfig AW_AXP
	bool "AXP Power drivers"
	depends on REGULATOR
	default y
	---help---
	This option allows you to select AXP power driver

if AW_AXP

config AW_AXP81X
	bool "AXP81X driver"
	---help---
	AXP81X driver

config AXP_TWI_USED
	bool "AXP use twi as transfer channel"
	default n

config AXP_NMI_USED
	bool "AXP use NMI as IRQ SRC"
	default n

endif # !AW_AXP
```

## SOFTWARE/A64-TERES/linux-a64teres/sound/soc/sunxi/Kconfig
```kconfig
#menu "ASoC support for SUNXI"
config SND_SOC_SUNXI_RW
	bool
config SND_SOC_SUNXI_AUDIO_DMA
	bool

config SND_SOC_SUNXI_TDM
	bool
menuconfig SND_SUNXI_SOC
	tristate "ASoC support for SUNXI"
	select SND_SOC_SUNXI_AUDIO_DMA
	#select SND_SOC_SUNXI_RW
	select SND_SOC_DMAENGINE_PCM
	#select SND_SOC_SUNXI_TDM

if SND_SUNXI_SOC
config SND_SOC_INTERNAL_AUDIOCODEC
	tristate "ASoC support for audiocodec"
	depends on ARCH_SUN50IW1P1
	select SND_SOC_SUNXI_RW
	help
	  Say Y or M if you want to add support for codecs attached to the
	  AUDIOCODEC interface.

config SND_SOC_INTERNAL_I2S
	tristate "ASoC support for internal-i2s"
	depends on ARCH_SUN50IW1P1
	select SND_SOC_SUNXI_RW
	help
	  Say Y or M if you want to add support for codecs attached to the
	  INTERNAL I2S interface.

config SND_SOC_AUDIO_CODEC_MACHINE
	tristate "ASoC support for audiocodec machine"
	depends on ARCH_SUN50IW1P1
	select SND_SOC_SUNXI_RW
	help
	  Say Y or M if you want to add support for codecs attached to the
	  AUDIOCODEC MACHEINE interface.

config SND_SOC_INTERNAL_SUN8IW10_AUDIOCODEC
	tristate "ASoC support for audiocodec"
	depends on ARCH_SUN8IW10
	select SND_SOC_SUNXI_RW
	help
	  Say Y or M if you want to add support for codecs attached to the
	  AUDIOCODEC interface.

config SND_SOC_INTERNAL_SUN8IW11_AUDIOCODEC
	tristate "ASoC support for audiocodec"
	depends on ARCH_SUN8IW11
	select SND_SOC_SUNXI_RW
	help
	  Say Y or M if you want to add support for codecs attached to the
	  AUDIOCODEC interface.

config SND_SOC_SUNXI_CODEC_CPU_DAI
	tristate "ASoC support for internal-codec cpudai"
	depends on ARCH_SUN8IW10 || ARCH_SUN8IW11
	select SND_SOC_SUNXI_RW
	help
	  Say Y or M if you want to add support for codecs attached to the
	  INTERNAL I2S interface.

config SND_SOC_SUN8IW10_AUDIO_CODEC_MACHINE
	tristate "ASoC support for sun8iw10 audiocodec machine"
	depends on ARCH_SUN8IW10
	select SND_SOC_SUNXI_RW
	help
	  Say Y or M if you want to add support for codecs attached to the
	  AUDIOCODEC MACHEINE interface.

config SND_SOC_SUN8IW11_AUDIO_CODEC_MACHINE
	tristate "ASoC support for sun8iw11 audiocodec machine"
	depends on ARCH_SUN8IW11
	select SND_SOC_SUNXI_RW
	help
	  Say Y or M if you want to add support for codecs attached to the
	  AUDIOCODEC MACHEINE interface.

config SND_SOC_DAUDIO_PLATFORM
	tristate "ASoC support for daudio platform."
	select SND_SOC_SUNXI_TDM
	help
 	  Say Y or M if you want to add the daudio platform interface.

config SND_SOC_VIRCODEC
	tristate "ASoC support for vircodec."
	help
 	  Say Y or M if you want to add the vircodec interface.

config SND_SOC_DAUDIO0_MACHINE
	tristate "ASoC support for daudio0 machine"
	select SND_SOC_SUNXI_TDM
	help
 	  Say Y or M if you want to add the daudio0 MACHEINE interface.


config SND_SOC_DAUDIO1_MACHINE
	tristate "ASoC support for daudio1 machine"
	select SND_SOC_SUNXI_TDM
	help
 	  Say Y or M if you want to add the daudio1 MACHEINE interface.

config SND_SOC_DMIC
	tristate "ASoC support for dmic."
	depends on ARCH_SUN8IW10
	help
 	  Say Y or M if you want to add the dmic interface.

config SND_SOC_CS4385
	tristate "dsd codec of cs4385."
	depends on ARCH_SUN8IW10
	help
 	  Say Y or M if you want to add the cs4385 codec interface.

config SND_SOC_DSD
	tristate "ASoC support for dsd."
	depends on ARCH_SUN8IW10
	help
 	  Say Y or M if you want to add the dsd interface.

config SND_SUNXI_SOC_HDMIAUDIO
	tristate "ASoC support for hdmiaudio."
	depends on ARCH_SUN50IW1P1 || ARCH_SUN8IW11
	select SND_SOC_SUNXI_TDM
	help
 	  Say Y or M if you want to add the hdmi platform interface.

config SND_SUNXI_SOC_SPDIF
	tristate "ASoC support for spdif soundcard"
	help
 	  Say Y or M if you want to add the spdif soundcard include macheine plarform.
config SND_SOC_HUB
	bool "Support SUNXI AUDIO HUB"
	depends on (SND_SUNXI_SOC_HDMIAUDIO && SND_SUNXI_SOC_SPDIF)
	help
	Say Y if you want to add audiohub function.

config SUNXI_AUDIO_DEBUG
	bool "Support SUNXI AUDIO DEBUG"
	help
	 this is DEBUG function, add by LSH
	depends on SND_SOC_SUNXI_AUDIO_DMA

endif



#endmenu
```
