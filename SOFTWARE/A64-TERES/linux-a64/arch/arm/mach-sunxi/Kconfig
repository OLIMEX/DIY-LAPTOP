## SOFTWARE/A64-TERES/linux-a64/drivers/devfreq/Kconfig
```kconfig
menuconfig PM_DEVFREQ
	bool "Generic Dynamic Voltage and Frequency Scaling (DVFS) support"
	help
	  A device may have a list of frequencies and voltages available.
	  devfreq, a generic DVFS framework can be registered for a device
	  in order to let the governor provided to devfreq choose an
	  operating frequency based on the device driver's policy.

	  Each device may have its own governor and policy. Devfreq can
	  reevaluate the device state periodically and/or based on the
	  notification to "nb", a notifier block, of devfreq.

	  Like some CPUs with CPUfreq, a device may have multiple clocks.
	  However, because the clock frequencies of a single device are
	  determined by the single device's state, an instance of devfreq
	  is attached to a single device and returns a "representative"
	  clock frequency of the device, which is also attached
	  to a device by 1-to-1. The device registering devfreq takes the
	  responsibility to "interpret" the representative frequency and
	  to set its every clock accordingly with the "target" callback
	  given to devfreq.

	  When OPP is used with the devfreq device, it is recommended to
	  register devfreq's nb to the OPP's notifier head.  If OPP is
	  used with the devfreq device, you may use OPP helper
	  functions defined in devfreq.h.

if PM_DEVFREQ

comment "DEVFREQ Governors"

config DEVFREQ_GOV_SIMPLE_ONDEMAND
	tristate "Simple Ondemand"
	help
	  Chooses frequency based on the recent load on the device. Works
	  similar as ONDEMAND governor of CPUFREQ does. A device with
	  Simple-Ondemand should be able to provide busy/total counter
	  values that imply the usage rate. A device may provide tuned
	  values to the governor with data field at devfreq_add_device().

config DEVFREQ_GOV_PERFORMANCE
	tristate "Performance"
	help
	  Sets the frequency at the maximum available frequency.
	  This governor always returns UINT_MAX as frequency so that
	  the DEVFREQ framework returns the highest frequency available
	  at any time.

config DEVFREQ_GOV_POWERSAVE
	tristate "Powersave"
	help
	  Sets the frequency at the minimum available frequency.
	  This governor always returns 0 as frequency so that
	  the DEVFREQ framework returns the lowest frequency available
	  at any time.

config DEVFREQ_GOV_USERSPACE
	tristate "Userspace"
	help
	  Sets the frequency at the user specified one.
	  This governor returns the user configured frequency if there
	  has been an input to /sys/devices/.../power/devfreq_set_freq.
	  Otherwise, the governor does not change the frequnecy
	  given at the initialization.

config DEVFREQ_GOV_ADAPTIVE
	depends on ARCH_SUN50I
	tristate "Adaptive"
	help
	  Sets the frequency according to dram master access or idle.

comment "DEVFREQ Drivers"

config ARM_EXYNOS4_BUS_DEVFREQ
	bool "ARM Exynos4210/4212/4412 Memory Bus DEVFREQ Driver"
	depends on CPU_EXYNOS4210 || CPU_EXYNOS4212 || CPU_EXYNOS4412
	select ARCH_HAS_OPP
	select DEVFREQ_GOV_SIMPLE_ONDEMAND
	help
	  This adds the DEVFREQ driver for Exynos4210 memory bus (vdd_int)
	  and Exynos4212/4412 memory interface and bus (vdd_mif + vdd_int).
	  It reads PPMU counters of memory controllers and adjusts
	  the operating frequencies and voltages with OPP support.
	  To operate with optimal voltages, ASV support is required
	  (CONFIG_EXYNOS_ASV).

config ARM_SUNXI_DRAM_DEVFREQ
	bool "ARM Sunxi Dram DEVFREQ Driver"
	depends on ARCH_SUN50I && PM_OPP
	select DEVFREQ_GOV_ADAPTIVE
	help
	  DRAM Frequency scaling allows you to change the clock speed of
	  DRAM on the fly. This is a nice method to save power, because
	  the lower the DRAM clock speed, the less power the DRAM consumes.

	  If in doubt, say N.

config DEVFREQ_DRAM_FREQ_IN_VSYNC
	bool "Change dram frequency in display vsync"
	depends on ARM_SUNXI_DRAM_DEVFREQ
	depends on ARCH_SUN50I
	help
	  This will allow dram frequency changed in display vsync.

	  If in doubt, say N.

config DEVFREQ_DRAM_FREQ_BUSFREQ
	bool "Change bus frequency with dram frequency changed when low-power music playing"
	depends on ARM_SUNXI_DRAM_DEVFREQ
	depends on ARCH_SUN50I
	help
	  This will allow bus frequency changed when low-power music playing.

	  If in doubt, say N.

config DEVFREQ_DRAM_FREQ_WITH_SOFT_NOTIFY
	bool "Use dram master notify access or idle in software"
	depends on ARM_SUNXI_DRAM_DEVFREQ
	depends on ARCH_SUN50I
	help
	  This will allow dram master notify access or idle instead of hardware interrupt.

	  If in doubt, say N.


endif # PM_DEVFREQ
```

## SOFTWARE/A64-TERES/linux-a64/drivers/input/touchscreen/aw5x06/Kconfig
```kconfig
#
#  Touchscreen driver configuration
#
config  TOUCHSCREEN_AW5X06_TS
       tristate  "aw5x06 touchscreen driver"      
       depends on INPUT && I2C
       default m
       help
         aw5x06 touchscreen driver    
```

## SOFTWARE/A64-TERES/linux-a64/drivers/input/touchscreen/gslx680/Kconfig
```kconfig
#
#  Touchscreen driver configuration
#
config  TOUCHSCREEN_GSLX680
       tristate  "gslX680 touchscreen driver"      
       depends on INPUT && I2C
       default m
       help
         gsl1680,gsl2680,gsl3680 touchscreen driver    
         
```

## SOFTWARE/A64-TERES/linux-a64/drivers/input/touchscreen/gt9xxf/Kconfig
```kconfig
#
#  Touchscreen driver configuration
#

config  TOUCHSCREEN_GT9XXF_TS
       tristate  "gt9XXF touchscreen driver"      
       depends on INPUT && I2C
       default m
       help
         gt9XXF touchscreen driver    
```

## SOFTWARE/A64-TERES/linux-a64/drivers/input/touchscreen/icn83xx/Kconfig
```kconfig
#
#  Touchscreen driver configuration
#

config  TOUCHSCREEN_ICN83XX_TS
       tristate  "icn83xx touchscreen driver"      
       depends on INPUT && I2C
       default m
       help
         icn83xx touchscreen driver    
```

## SOFTWARE/A64-TERES/linux-a64/drivers/media/platform/sunxi-vfe/Kconfig
```kconfig
config CSI_VFE
	tristate "v4l2 driver for SUNXI"
	default m
	select VIDEOBUF2_DMA_CONTIG
	
```

## SOFTWARE/A64-TERES/linux-a64/drivers/net/ethernet/allwinner/Kconfig
```kconfig
#
# Allwinner device configuration
#

config NET_VENDOR_ALLWINNER
	bool "Allwinner devices"
	default y

	depends on ARCH_SUNXI
	---help---
	  If you have a network (Ethernet) card belonging to this
	  class, say Y and read the Ethernet-HOWTO, available from
	  <http://www.tldp.org/docs.html#howto>.

	  Note that the answer to this question doesn't directly
	  affect the kernel: saying N will just cause the configurator
	  to skip all the questions about Allwinner cards. If you say Y,
	  you will be asked for your specific card in the following
	  questions.

if NET_VENDOR_ALLWINNER

config SUN4I_EMAC
        tristate "Allwinner A10 EMAC support"
	depends on ARCH_SUNXI
	depends on OF
	select CRC32
	select MII
	select PHYLIB
	select MDIO_SUN4I
        ---help---
          Support for Allwinner A10 EMAC ethernet driver.

          To compile this driver as a module, choose M here.  The module
          will be called sun4i-emac.

config SUNXI_GMAC
        tristate "Allwinner GMAC support"
	depends on ARCH_SUNXI
	depends on OF
	select CRC32
	select MII
	select PHYLIB
	select MDIO_SUNXI
        ---help---
          Support for Allwinner Gigabit ethernet driver.

          To compile this driver as a module, choose M here.  The module
          will be called sunxi-gmac.

if SUNXI_GMAC
config GETH_SCRIPT_SYS
	bool "Use sunxi platform script"
	depends on SUNXI_GMAC
	default y
	---help---
	 The gabit ethernet gpio request and control by the script
	 of sunxi platform. Select it, by script. If not, ioremap
	 by drivers itself.

config GETH_CLK_SYS
	bool "Clock use system interface"
	depends on SUNXI_GMAC
	default y
	---help---
	 It select the clock controler is system or the driver itself.
	 If you want to use the system interface, select it. If not, the
	 driver will control the clock by ioremap.

config GETH_PHY_POWER
	bool "External PHY power control"
	depends on SUNXI_GMAC && REGULATOR
	default y
	---help---
	 If external PHY power is exist, and it want to be controled,
	 select it.  If not, it mean the power of PHY already on.
endif

endif # NET_VENDOR_ALLWINNER
```

## SOFTWARE/A64-TERES/linux-a64/drivers/soc/allwinner/Kconfig
```kconfig
#
config SUNXI_SRAM
	bool "Allwinner SOC SRAM controlloer"
	default ARCH_SUNXI
	help
	  Say y here to enable the SRAM controller support. This
	  device is responsible on mapping the SRAM in the sunXi SoCs
	  whether to the CPU/DMA, or to the devices.
```

## SOFTWARE/A64-TERES/linux-a64/drivers/usb/sunxi_usb/Kconfig
```kconfig
#
# softwinner SUNXI USB2.0 Dual Role Controller Driver.
#

#---------------------------------------------
#-
#- config USB2.0 Dual Role Controller.
#-
#---------------------------------------------
menuconfig USB_SUNXI_USB
    tristate "SUNXI USB2.0 Dual Role Controller support"
    depends on ARCH_SUNXI
    help
        SUNXI USB2.0 Dual Role Controller

config USB_SUNXI_USB_MANAGER
    tristate "SUNXI USB2.0 Manager"
    depends on USB_SUNXI_USB
    help
        manager all usb controller.

config USB_SUNXI_USB_DEBUG
    tristate "SUNXI USB driver debug message"
    depends on USB_SUNXI_USB
    help
        SUNXI USB driver debug message.

config USB_SUNXI_USB_ADB
    tristate "SUNXI USB driver use adb source"
    depends on USB_SUNXI_USB
    help
        SUNXI USB driver debug message.
```

## SOFTWARE/A64-TERES/linux-a64/drivers/video/sunxi/Kconfig
```kconfig
#
# Video configuration for sunxi platform
#

menu "Video support for sunxi"
	depends on FB

config FB_CONSOLE_SUNXI
  bool "Framebuffer Console Support(sunxi)"
  select FB_CFB_FILLRECT
  select FB_CFB_COPYAREA
  select FB_CFB_IMAGEBLIT
  default n
  ---help---

config DISP2_SUNXI
  tristate "DISP Driver Support(sunxi-disp2)"
  depends on (ARCH_SUN50I)
  select FB_BACKLIGHT
  default n
  ---help---

config HDMI_DISP2_SUNXI
	tristate "HDMI Driver Support(sunxi-disp2)"
	depends on (DISP2_SUNXI)
	default n
	---help---

config DISP2_SUNXI_BOOT_COLORBAR
  bool "boot colorbar for disp driver(sunxi-disp2)"
  depends on DISP2_SUNXI
  default n
  ---help---

config DISP2_SUNXI_DEBUG
  bool "debugfs for disp driver(sunxi-disp2)"
  depends on DISP2_SUNXI
  default n
  ---help---

endmenu
```
