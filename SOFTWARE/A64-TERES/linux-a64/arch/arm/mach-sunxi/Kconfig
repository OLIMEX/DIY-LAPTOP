## SOFTWARE/A64-TERES/linux-a64teres/drivers/arisc/Kconfig
```kconfig
#
# sunxi arisc driver configuration.
#
config SUNXI_ARISC
	tristate "sunxi arisc driver"
	depends on ARCH_SUNXI && HWSPINLOCK_SUNXI
	help
	  Arisc driver support sunxi family SOCs.
	  Previously known as "ar100" or "cpus".
	  Set y here to support the sunxi arisc driver.
	  If unsure, set N.
```

## SOFTWARE/A64-TERES/linux-a64teres/drivers/char/sunxi-di/Kconfig
```kconfig
config SUNXI_DI
	tristate "allwinnertech DE-Interlace driver"
	default n
	help
	  This is an option for de-interlace.
```

## SOFTWARE/A64-TERES/linux-a64teres/drivers/char/sunxi-scr/Kconfig
```kconfig
config SUNXI_SCR
	tristate "allwinnertech smartcard driver"
	default n
	help
	  This is an option for use by developers; most people should
	  say N here.  This adds a lot of debugging output to dmesg.
```

## SOFTWARE/A64-TERES/linux-a64teres/drivers/char/sunxi_sys_info/Kconfig
```kconfig
#
# sunxi system information driver.
#

config SUNXI_SYS_INFO
	tristate "sunxi system info driver"
	default y
```

## SOFTWARE/A64-TERES/linux-a64teres/drivers/char/timer_test/Kconfig
```kconfig
#
# sunxi timer test configuration.
#

config SUNXI_TIMER_TEST
	tristate "sunxi timer test driver"
	default m
	help
	Nothing help.
```

## SOFTWARE/A64-TERES/linux-a64teres/drivers/crypto/sunxi/Kconfig
```kconfig
config CRYPTO_SUNXI
	tristate "SUNXI SS controller"
	depends on ARCH_SUNXI
	help
	  To compile this driver as a module, choose M here: the module
	  will be called caam.
```
